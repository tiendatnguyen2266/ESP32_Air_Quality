#if CONFIG_FREERTOS_UNICORE
#define ARDUINO_RUNNING_CORE 0
#else
#define ARDUINO_RUNNING_CORE 1
#endif

#include <freertos/semphr.h>
#include <TaskScheduler.h>

#include "ThingSpeak.h"

#include <FirebaseESP32.h>
#include <UrlEncode.h>
#include <HTTPClient.h>

#include <WiFi.h>
#include <Wire.h>
#include "bsec.h"

#include <ArduinoJson.h>
#include <WiFiClientSecure.h>

#include <TFT_eSPI.h>
#include <SPI.h>

#include <NTPClient.h>
#include <WiFiUdp.h>
#include <SimpleTimer.h>

// Định nghĩa chân và các biến liên quan đến phần cứng
#define LED_BUILTIN 2

int ledMode = 12;
int BUZZER_PIN = 13;
int BUTTON_PIN = 14;

int BUTTON_PIN_SHEET = 19;  // Chân nút nhấn mới
int LED_PIN_SHEET = 17;     // Chân LED mới


int mucCanhbao;
boolean buttonState=HIGH;
boolean runMode;//Bật/tắt chế độ cảnh báo

double thresholdTemperature;
double thresholdHumidity;
double thresholdCO2;
double thresholdVOC;

double temperatureLv1, temperatureLv2, temperatureLv3, temperatureLv4;
double humidityLv1, humidityLv2, humidityLv3, humidityLv4;
double co2Lv1, co2Lv2, co2Lv3, co2Lv4;
double vocLv1, vocLv2, vocLv3, vocLv4;

#define LED_GREEN 25
#define LED_YELLOW 26
#define LED_RED 27

TFT_eSPI tft = TFT_eSPI();

#define SCREEN_WIDTH 320
#define SCREEN_HEIGHT 240

// Định nghĩa màu sắc
#define BLACK 0x0000    
#define BLUE 0x001F    
#define RED 0xF800      
#define GREEN 0x07E0
#define CYAN 0x07FF
#define MAGENTA 0xF81F  
#define YELLOW 0xFFE0
#define WHITE 0xFFFF 
#define ORANGE 0xFD00
#define PURPLE 0xF81F
#define MARRON 0x8000

Scheduler taskScheduler;

Bsec iaqSensor;
String output;

// Khai báo các hàm chức năng
void setupLCD(void);
void getIAQ(void);
void updateIAQLCD(void);
void updateIAQ(void);
void checkIAQ(void);
void getThoigian(void);
void updateTimeLCD(void);
void updateTime(void);
void alarm(void);
void ButtonAlarm(void);
void updateFirebase(void);
void checkIaqSensorStatus(void);
void errLeds(void);

float temperature;
float humidity;
float IAQ;
float carbon;
float VOC;
const char* IAQsts;
int staticIaqGroup;

const int measurePin = 33;
const int ledPower = 16;

unsigned int samplingTime = 280;
unsigned int deltaTime = 40;
unsigned int sleepTime = 9680;

float voMeasured = 0;
float calcVoltage = 0;

char _buffer[100];
char buf[50];

//Hàm Filter giúp làm mịn dữ liệu bằng cách lấy trung bình của 10 giá trị đầu vào gần nhất giúp giảm thiểu các biến động nhỏ và nhiễu trong dữ liệu làm cho giá trị đo lường ổn định
int Filter(int m)
{
  static int flag_first = 0, _buff[10], sum;
  const int _buff_max = 10;
  int i;
  
  if(flag_first == 0)
  {
    flag_first = 1;
    for(i = 0, sum = 0; i < _buff_max; i++)
    {
      _buff[i] = m;
      sum += _buff[i];
    }
    return m;
  }
  else
  {
    sum -= _buff[0];
    for(i = 0; i < (_buff_max - 1); i++)
    {
      _buff[i] = _buff[i + 1];
    }
    _buff[9] = m;
    sum += _buff[9];
    
    i = sum / 10.0;
    return i;
  }
}

//Mã icon nhiệt độ
const unsigned short nhietdo[400] PROGMEM={
0x0000, 0x0000, 0x0000, 0x0000, 0x0000, 0x0000, 0x0000, 0xFE66, 0xF5C6, 0xFC80, 0x0000, 0xE71F, 0xE71F, 0xDEDF, 0xDEFF, 0x0000,   // 0x0010 (16) pixels
0x0000, 0x0000, 0x0000, 0x0000, 0x0000, 0x0000, 0x0000, 0x0000, 0xFD45, 0xFDC7, 0xF5A7, 0xFDC8, 0xFDC7, 0xFDA0, 0xDF3F, 0xE73F,   // 0x0020 (32) pixels
0xEF5F, 0xE73F, 0xD6BF, 0x0000, 0x0000, 0x0000, 0x0000, 0x0000, 0x0000, 0x0000, 0x0000, 0x0000, 0x0000, 0xF5A7, 0xF5C6, 0xED84,   // 0x0030 (48) pixels
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0x0000, 0x0000, 0x0000, 0x0000, 0x0000, 0x0000, 0xD6FF, 0xE7BF, 0xDF9F, 0xDF5F, 0xD75F, 0xD69F, 0x0000, 0x0000, 0x0000, 0x0000,   // 0x0190 (400) pixels
};

//Mã icon kí hiệu độ
const static unsigned char icondo[]= {
  0x00, 0x00, 0x3f, 0x00, 0x3f, 0x00, 0x33, 0x00, 0x33, 0x00, 0x3f, 0x00, 0x3f, 0x00, 0x00, 0x00, 
  0x00, 0x00, 0x00, 0x00, 0x00, 0x00, 0x00, 0x00, 0x00, 0x00, 0x00, 0x00, 0x00, 0x00, 0x00, 0x00, 
  0x00, 0x00, 0x00, 0x00, 0x00, 0x00, 0x00, 0x00
};

//Mã icon độ ẩm
const unsigned short doam[400] PROGMEM={
0x0000, 0x0000, 0x0000, 0x0000, 0x0000, 0x0000, 0x0000, 0x0000, 0x0000, 0x0000, 0x0000, 0x0000, 0x0000, 0x0000, 0x0000, 0x0000,   // 0x0010 (16) pixels
0x0000, 0x0000, 0x0000, 0x0000, 0x0000, 0x0000, 0x0000, 0x0000, 0x0000, 0x0000, 0x1D3F, 0x1DDF, 0x1D5F, 0x0000, 0x0000, 0x0000,   // 0x0020 (32) pixels
0x0000, 0x0000, 0x0000, 0x153F, 0x157F, 0x0000, 0x0000, 0x0000, 0x0000, 0x0000, 0x0000, 0x0000, 0x0000, 0x2DDF, 0x1D5F, 0x1E1F,   // 0x0030 (48) pixels
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0x0000, 0x0000, 0x0000, 0x2D5F, 0x0000, 0x0000, 0x0000, 0x0000, 0x0000, 0x0000, 0x0000, 0x0000, 0x0000, 0x0000, 0x0000, 0x0000,   // 0x0190 (400) pixels
};

//Mã icon thang đo 
const unsigned short thangdo[280] PROGMEM={
0x7FAE, 0x778D, 0x77AC, 0x77AB, 0x7FCB, 0x7FAA, 0x976B, 0xAF8C, 0xBF6C, 0xBF0B, 0xC72C, 0xCF2D, 0xD70D, 0xC66D, 0xC5EE, 0xC5AE,   // 0x0010 (16) pixels
0xD5CF, 0xD5AE, 0xD58F, 0xE5B0, 0xDCCF, 0xDC90, 0xDC90, 0xDC90, 0xDCB1, 0xD4B3, 0xC519, 0xC5DE, 0xB5DF, 0xADFF, 0xB61F, 0xB5FF,   // 0x0020 (32) pixels
0xB61F, 0xAD7B, 0xA494, 0xAC92, 0xB4B2, 0xB4D2, 0xACB2, 0xB4D3, 0x5709, 0x4EA7, 0x4EC6, 0x4EC5, 0x4EA5, 0x4E64, 0x7EC6, 0xAFAA,   // 0x0030 (48) pixels
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0x8CBB, 0x6B94, 0x5A4C, 0x624B, 0x6A6B, 0x6A8B, 0x6A6B, 0x72CC
};

//Mã icon PM2.5
const unsigned short airquality[1369] PROGMEM={
0x0000, 0x0000, 0x0000, 0x0000, 0x0000, 0x0000, 0x0000, 0x0000, 0x0000, 0x0000, 0x0000, 0x0000, 0x0000, 0x0000, 0x0000, 0x0000,   // 0x0010 (16) pixels
0x0000, 0x0000, 0x0000, 0x0000, 0x0000, 0x0000, 0x0000, 0x0000, 0x0000, 0x0000, 0x0000, 0x0120, 0x01E0, 0x01C0, 0x00E0, 0x0000,   // 0x0020 (32) pixels
0x0000, 0x0000, 0x0000, 0x0000, 0x0000, 0x0000, 0x0000, 0x0000, 0x0000, 0x0000, 0x0000, 0x0000, 0x0000, 0x0000, 0x0000, 0x0000,   // 0x0030 (48) pixels
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0x0000, 0x0000, 0x0000, 0x0000, 0x0000, 0x0000, 0x0000, 0x0000, 0x0000
};

FirebaseData fbdo;
FirebaseAuth auth;
FirebaseConfig config;

// const char* ssid = "Nike On My Feat";  // Nhập ID Wifi
// const char* password = "0981934731";  //Nhập mật khẩu Wifi

const char* ssid = "Tron Lo";  // Nhập ID Wifi
const char* password = "21112003";  //Nhập mật khẩu Wifi

WiFiClient  client;

unsigned long myChannelNumber = 2;
const char * myWriteAPIKey = "KDLYT47PO7T4IV4T";

WiFiClientSecure espClient;

WiFiUDP ntpUDP;
NTPClient timeClient(ntpUDP, "pool.ntp.org");
// Ngày trong tuần
String weekDays[7]={"Sun", "Mon", "Tue", "Wed", "Thu", "Fri", "Sat"};
int gio, phut, giay, ngay, thang, nam;
String thu;

SemaphoreHandle_t xLcdSemaphore;

// Khai báo các hàm tác vụ
void updateTimeTask(void *pvParameters);
void updateLCDTask(void *pvParameters);
void alarmTask(void *pvParameters);
void updateFirebaseTask(void *pvParameters);
void thingSpeakTask(void *pvParameters);

void setup() {
  Serial.begin(115200);
  Serial.println("Connecting to " +String(ssid)); //Ket noi vao mang wifi
  WiFi.begin(ssid, password);                 
  while ( WiFi.status() != WL_CONNECTED ) {
    delay ( 500 );
    Serial.print ( "." );
  }
  Serial.println("");
  Serial.println("WiFi connected");
  Serial.println("IP address: ");
  Serial.println(WiFi.localIP());

  // Khởi tạo cảm biến 
  delay(200);
  Wire.begin();
  pinMode(LED_BUILTIN, OUTPUT);

  iaqSensor.begin(BME68X_I2C_ADDR_LOW, Wire);
  output = "\nBSEC library version " + String(iaqSensor.version.major) + "." + String(iaqSensor.version.minor) + "." + String(iaqSensor.version.major_bugfix) + "." + String(iaqSensor.version.minor_bugfix);
  Serial.println(output);
  checkIaqSensorStatus();

  bsec_virtual_sensor_t sensorList[13] = {
    BSEC_OUTPUT_IAQ,
    BSEC_OUTPUT_STATIC_IAQ,
    BSEC_OUTPUT_CO2_EQUIVALENT,
    BSEC_OUTPUT_BREATH_VOC_EQUIVALENT,
    BSEC_OUTPUT_RAW_TEMPERATURE,
    BSEC_OUTPUT_RAW_PRESSURE,
    BSEC_OUTPUT_RAW_HUMIDITY,
    BSEC_OUTPUT_RAW_GAS,
    BSEC_OUTPUT_STABILIZATION_STATUS,
    BSEC_OUTPUT_RUN_IN_STATUS,
    BSEC_OUTPUT_SENSOR_HEAT_COMPENSATED_TEMPERATURE,
    BSEC_OUTPUT_SENSOR_HEAT_COMPENSATED_HUMIDITY,
    BSEC_OUTPUT_GAS_PERCENTAGE
  };

  iaqSensor.updateSubscription(sensorList, 13, BSEC_SAMPLE_RATE_LP);
  checkIaqSensorStatus();

  // Print the header
  output = "Timestamp [ms], IAQ, IAQ accuracy, Static IAQ, CO2 equivalent, breath VOC equivalent, raw temp[°C], pressure [hPa], raw relative humidity [%], gas [Ohm], Stab Status, run in status, comp temp[°C], comp humidity [%], gas percentage";
  Serial.println(output);

  config.database_url = "https://do-an-2-dcead-default-rtdb.firebaseio.com/";
  config.api_key = "AIzaSyAIOTB2_TEK3EVVzHqZWbhyJ2rmcmF63x8";
  //auth.user.email = "YOUR_EMAIL";
  //auth.user.password = "YOUR_PASSWORD";
  Firebase.begin(&config, &auth);
  Firebase.reconnectWiFi(true);

  // Đọc các ngưỡng từ Firebase
  updateThresholdsFromFirebase();

  if (Firebase.getInt(fbdo, "/arlam")) {
    runMode = fbdo.intData();
    digitalWrite(ledMode, runMode);
  }

  setupLCD();  
  timeClient.begin();                             
  timeClient.setTimeOffset(25200);   // GMT +7 (7*3600)

  getThoigian();                                  
  updateTimeLCD();

  xLcdSemaphore = xSemaphoreCreateMutex();

  // Khởi tạo các nhiệm vụ FreeRTOS
  xTaskCreatePinnedToCore(updateTimeTask, "updateTimeTask", 4096, NULL, 3, NULL, ARDUINO_RUNNING_CORE);
  xTaskCreatePinnedToCore(updateLCDTask, "updateLCDTask", 4096, NULL, 2, NULL, ARDUINO_RUNNING_CORE);
  xTaskCreatePinnedToCore(alarmTask, "alarmTask", 4096, NULL, 1, NULL, ARDUINO_RUNNING_CORE);
  xTaskCreatePinnedToCore(updateFirebaseTask, "updateFirebaseTask", 6144, NULL, 1, NULL, ARDUINO_RUNNING_CORE);
  xTaskCreatePinnedToCore(thingSpeakTask, "thingSpeakTask", 4096, NULL, 1, NULL, ARDUINO_RUNNING_CORE);

  pinMode(ledPower, OUTPUT);
  pinMode(BUZZER_PIN, OUTPUT);
  pinMode(BUTTON_PIN, INPUT_PULLUP);
  pinMode(ledMode,OUTPUT);
  digitalWrite(BUZZER_PIN,LOW);

  pinMode(BUTTON_PIN_SHEET, INPUT_PULLUP);
  pinMode(LED_PIN_SHEET, OUTPUT);

  pinMode(LED_GREEN, OUTPUT);
  pinMode(LED_YELLOW, OUTPUT);
  pinMode(LED_RED, OUTPUT);

  ThingSpeak.begin(client); 

  espClient.setInsecure();
}

void loop() {
  // Vòng lặp chính không có nội dung
}

void updateTimeTask(void *pvParameters) {
  for (;;) {
    updateTime();
    Serial.printf("Time Task Stack High Water Mark: %d\n", uxTaskGetStackHighWaterMark(NULL));
    vTaskDelay(1000 / portTICK_PERIOD_MS); // Đợi 1 giây trước khi cập nhật lại
  }
}

void updateLCDTask(void *pvParameters) {
  for (;;) {
    LCD();
    Serial.printf("LCD Task Stack High Water Mark: %d\n", uxTaskGetStackHighWaterMark(NULL));
    vTaskDelay(2000 / portTICK_PERIOD_MS); // Đợi 2 giây trước khi cập nhật lại
  }
}

void updateFirebaseTask(void *pvParameters) {
  for (;;) {
    buttonAlarm();
    vTaskDelay(1000 / portTICK_PERIOD_MS);
    updateSheet();
    vTaskDelay(1000 / portTICK_PERIOD_MS);
    updateFirebase();
    Serial.printf("Firebase Task Stack High Water Mark: %d\n", uxTaskGetStackHighWaterMark(NULL));
    vTaskDelay(1000 / portTICK_PERIOD_MS); 
  }
}

void alarmTask(void *pvParameters) {
  for (;;) {
    alarm();
    Serial.printf("Alarm Task Stack High Water Mark: %d\n", uxTaskGetStackHighWaterMark(NULL));
    vTaskDelay(2000 / portTICK_PERIOD_MS); // Đợi 2 giây trước khi cập nhật lại
  }
}

void thingSpeakTask(void *pvParameters) {
  for (;;) {
    sendToThingSpeak();
    Serial.printf("ThingSpeak Task Stack High Water Mark: %d\n", uxTaskGetStackHighWaterMark(NULL));
    vTaskDelay(15000 / portTICK_PERIOD_MS); // Chờ 15 giây trước khi gửi cập nhật tiếp theo
  }
}


float previousTemperature = -999.0;
float previousHumidity = -999.0;
float previousStaticIaq = -1.0;
float previousCO2Equivalent = -1.0;
float previousBreathVocEquivalent = -1.0;
bool iaqDataChanged = false;

void getIAQ(){
  unsigned long time_trigger = millis();
  if (iaqSensor.run()) { // If new data is available
    digitalWrite(LED_BUILTIN, LOW);
    output = String(time_trigger);
    output += ", " + String(iaqSensor.iaq);
    output += ", " + String(iaqSensor.iaqAccuracy);
    output += ", " + String(iaqSensor.staticIaq);
    output += ", " + String(iaqSensor.co2Equivalent);
    output += ", " + String(iaqSensor.breathVocEquivalent);
    output += ", " + String(iaqSensor.rawTemperature);
    output += ", " + String(iaqSensor.pressure);
    output += ", " + String(iaqSensor.rawHumidity);
    output += ", " + String(iaqSensor.gasResistance);
    output += ", " + String(iaqSensor.stabStatus);
    output += ", " + String(iaqSensor.runInStatus);
    output += ", " + String(iaqSensor.temperature);
    output += ", " + String(iaqSensor.humidity);
    output += ", " + String(iaqSensor.gasPercentage);
    Serial.println(output);
    digitalWrite(LED_BUILTIN, HIGH);
  } else {
    checkIaqSensorStatus();
  }

  if (iaqSensor.temperature != previousTemperature || 
        iaqSensor.humidity != previousHumidity || 
        iaqSensor.staticIaq != previousStaticIaq || 
        iaqSensor.co2Equivalent != previousCO2Equivalent || 
        iaqSensor.breathVocEquivalent != previousBreathVocEquivalent) {
    iaqDataChanged = true;

    previousTemperature = iaqSensor.temperature;
    previousHumidity = iaqSensor.humidity;
    previousStaticIaq = iaqSensor.staticIaq;
    previousCO2Equivalent = iaqSensor.co2Equivalent;
    previousBreathVocEquivalent = iaqSensor.breathVocEquivalent;
  } else {
    iaqDataChanged = false;
  }

  Serial.print("Temperature = "); 
  Serial.print(iaqSensor.temperature); 
  Serial.println(" *C");

  Serial.print("Humidity = "); 
  Serial.print(iaqSensor.humidity); 
  Serial.println(" %");

  Serial.print("IAQ = "); 
  Serial.print(iaqSensor.staticIaq); 
  Serial.println(" PPM");

  Serial.print("CO2 equiv = "); 
  Serial.print(iaqSensor.co2Equivalent); 
  Serial.println(" PPM");

  Serial.print("Breath VOC = "); 
  Serial.print(iaqSensor.breathVocEquivalent); 
  Serial.println(" PPM");
}

//Biến _buffer đóng vai trò là một bộ nhớ tạm thời để lưu trữ các chuỗi ký tự được định dạng từ các giá trị số đo khác nhau
//sprintf để định dạng các giá trị này thành chuỗi giúp việc hiển thị chúng trên màn hình trở nên dễ dàng và gọn gàng hơn
void updateIAQLCD() {
  sprintf(_buffer, "%02u", (int)iaqSensor.temperature);
  tft.setCursor(23, 83); // Hiển thị nhiệt độ
  
  // Biến để lưu màu của nhiệt độ
  uint16_t tempColor;

  if (iaqSensor.temperature <= temperatureLv1) {
    tempColor = GREEN;
  } else if (iaqSensor.temperature <= temperatureLv2) {
    tempColor = YELLOW;
  } else if (iaqSensor.temperature <= temperatureLv3) {
    tempColor = ORANGE;
  } else {
    tempColor = RED;
  }

  tft.setTextColor(tempColor, BLACK);
  tft.setTextSize(2);
  tft.print(_buffer);

  // Vẽ biểu tượng độ với cùng màu
  tft.drawBitmap(44, 83, icondo, 10, 20, tempColor);
  
  tft.setCursor(53, 83);
  tft.print("C");

  sprintf(_buffer, "%02u%%", (int)iaqSensor.humidity);
  tft.setCursor(89, 83);
  if (iaqSensor.humidity <= humidityLv1) {
    tft.setTextColor(GREEN, BLACK);
  } else if (iaqSensor.humidity <= humidityLv2) {
    tft.setTextColor(YELLOW, BLACK);
  } else if (iaqSensor.humidity <= humidityLv3) {
    tft.setTextColor(ORANGE, BLACK);
  } else {
    tft.setTextColor(RED, BLACK);
  }
  tft.setTextSize(2);
  tft.print(_buffer);

  sprintf(_buffer, "%4u", (int)iaqSensor.co2Equivalent);
  tft.setCursor(7, 122);
  if (iaqSensor.co2Equivalent <= co2Lv1) {
    tft.setTextColor(GREEN, BLACK);
  } else if (iaqSensor.co2Equivalent <= co2Lv2) {
    tft.setTextColor(YELLOW, BLACK);
  } else if (iaqSensor.co2Equivalent <= co2Lv3) {
    tft.setTextColor(ORANGE, BLACK);
  } else {
    tft.setTextColor(RED, BLACK);
  }
  tft.setTextSize(2);
  tft.print(_buffer);

  sprintf(_buffer, "%1u.%02u", (int)iaqSensor.breathVocEquivalent, ((long)(iaqSensor.breathVocEquivalent * 100) % 100));
  tft.setCursor(72, 122);
  if (iaqSensor.breathVocEquivalent <= vocLv1) {
    tft.setTextColor(GREEN, BLACK);
  } else if (iaqSensor.breathVocEquivalent <= vocLv2) {
    tft.setTextColor(YELLOW, BLACK);
  } else if (iaqSensor.breathVocEquivalent <= vocLv3) {
    tft.setTextColor(ORANGE, BLACK);
  } else {
    tft.setTextColor(RED, BLACK);
  }
  tft.setTextSize(2);
  tft.print(_buffer);
}


void updateIAQ() {
  getIAQ();
  if (iaqDataChanged) {
    updateIAQLCD();
  }
}

int previousStaticIaqGroup = -1;

void checkIAQ(){
    if ((iaqSensor.staticIaq > 0)  && (iaqSensor.staticIaq  <= 50))    {
        staticIaqGroup = 1;
    } 
    if ((iaqSensor.staticIaq > 51)  && (iaqSensor.staticIaq  <= 100))  {
        staticIaqGroup = 2;
    } 
    if ((iaqSensor.staticIaq > 101)  && (iaqSensor.staticIaq  <= 150)) {
        staticIaqGroup = 3;
    } 
    if ((iaqSensor.staticIaq > 151)  && (iaqSensor.staticIaq  <= 200)) {
        staticIaqGroup = 4;
    } 
    if ((iaqSensor.staticIaq > 201)  && (iaqSensor.staticIaq  <= 300)) {
        staticIaqGroup = 5;
    } 
    if ((iaqSensor.staticIaq > 301)  && (iaqSensor.staticIaq  <= 500)) {
        staticIaqGroup = 6;
    }

    if (staticIaqGroup != previousStaticIaqGroup) {
      previousStaticIaqGroup = staticIaqGroup;
      switch (staticIaqGroup) {
      case 1: // Good
        IAQsts = "Good";
        tft.fillRect(27,148,59,10, BLACK);

        sprintf(buf, "%4s", "Good");
        printText(buf,GREEN,27,148,1);

        Serial.print("IAQ: Good");

        digitalWrite(LED_GREEN,HIGH);
        digitalWrite(LED_YELLOW,LOW);
        digitalWrite(LED_RED,LOW);
        break;
      case 2: // Average
        IAQsts = "Average";
        tft.fillRect(27,148,59,10, BLACK);
        
        sprintf(buf, "%7s", "Average");
        printText(buf,YELLOW,27,148,1);
        Serial.print("IAQ: Average");

        digitalWrite(LED_GREEN,LOW);
        digitalWrite(LED_YELLOW,HIGH);
        digitalWrite(LED_RED,LOW);
        break;
      case 3: // Little Bad
        IAQsts = "Little Bad";
        tft.fillRect(27,148,59,10, BLACK);
        sprintf(buf, "%10s", "Little Bad");

        printText(buf,ORANGE,27,148,1);
        Serial.print("IAQ: Little Bad");

        digitalWrite(LED_GREEN,LOW);
        digitalWrite(LED_YELLOW,HIGH);
        digitalWrite(LED_RED,LOW);
        break;
      case 4: // Bad
        IAQsts = "Bad";
        tft.fillRect(27,148,59,10, BLACK);
        sprintf(buf, "%3s", "Bad");

        printText(buf,RED,27,148,1);
        Serial.print("IAQ: Bad");

        digitalWrite(LED_GREEN,LOW);
        digitalWrite(LED_YELLOW,LOW);
        digitalWrite(LED_RED,HIGH);

        break;
      case 5: // Worse
        IAQsts = "Worse";
        tft.fillRect(27,148,59,10, BLACK);
        sprintf(buf, "%5s", "Worse");

        printText(buf,PURPLE,27,148,1);
        Serial.print("IAQ: Worse");

        digitalWrite(LED_GREEN,LOW);
        digitalWrite(LED_YELLOW,LOW);
        digitalWrite(LED_RED,HIGH);
        
        break;
      case 6: // Very Bad
        IAQsts = "Very Bad";
        tft.fillRect(27,148,59,10, BLACK);
        sprintf(buf, "%8s", "Very Bad");

        printText(buf,MARRON,27,148,1);
        Serial.print("IAQ: Very Bad");

        digitalWrite(LED_GREEN,LOW);
        digitalWrite(LED_YELLOW,LOW);
        digitalWrite(LED_RED,HIGH);

        break;
      default:
          // Xử lý khi giá trị không thuộc các nhóm trên
        break;
      }   
    }   
}


void buttonAlarm() {
  if(digitalRead(BUTTON_PIN)==LOW){
    if(buttonState==HIGH){
      buttonState=LOW;
      runMode=!runMode;
      digitalWrite(ledMode,runMode);
      Serial.println("Run mode: " + String(runMode));

      Firebase.setInt(fbdo, "/arlam", runMode);
      delay(200);
    }
  }else{
    buttonState=HIGH;
  }
}

void alarm() {
  // Kiểm tra ngưỡng cảnh báo và bật/tắt cảnh báo
  if (runMode == 1) {
    if (iaqSensor.temperature > thresholdTemperature || 
        iaqSensor.humidity > thresholdHumidity || 
        iaqSensor.co2Equivalent > thresholdCO2 || 
        iaqSensor.breathVocEquivalent > thresholdVOC) {

      for (int i = 0; i < 1800; i += 200) {
        digitalWrite(BUZZER_PIN, HIGH); // Bật buzzer
        delay(100); // Thời gian giữa các âm thanh "tick tick"
        // vTaskDelay(100 / portTICK_PERIOD_MS); // Thời gian giữa các âm thanh "tick tick"
        digitalWrite(BUZZER_PIN, LOW); // Tắt buzzer
        // vTaskDelay(100 / portTICK_PERIOD_MS); // Thời gian giữa các âm thanh "tick tick"
        delay(100);
      }

      Serial.println("Đã bật cảnh báo!");
    } else {
      digitalWrite(BUZZER_PIN, LOW);
      Serial.println("Đã tắt cảnh báo!");
    }
  } else {
    digitalWrite(BUZZER_PIN, LOW);
    Serial.println("Đã tắt cảnh báo!");
  }
}

void updateThresholdsFromFirebase() {
  // Đọc ngưỡng từ Firebase và cập nhật
  if (Firebase.getInt(fbdo, "/threshold temperature")) {
    thresholdTemperature = fbdo.intData();
  }
  if (Firebase.getInt(fbdo, "/threshold humidity")) {
    thresholdHumidity = fbdo.intData();
  }
  if (Firebase.getInt(fbdo, "/threshold co2")) {
    thresholdCO2 = fbdo.intData();
  }
  if (Firebase.getFloat(fbdo, "/threshold voc")) {
    thresholdVOC = fbdo.floatData();
  }

  if (Firebase.getInt(fbdo, "/temperature lv1")) {
    temperatureLv1 = fbdo.intData();
  }
  if (Firebase.getInt(fbdo, "/temperature lv2")) {
    temperatureLv2 = fbdo.intData();
  }
  if (Firebase.getInt(fbdo, "/temperature lv3")) {
    temperatureLv3 = fbdo.intData();
  }
  if (Firebase.getInt(fbdo, "/temperature lv4")) {
    temperatureLv4 = fbdo.intData();
  }

  if (Firebase.getInt(fbdo, "/humidity lv1")) {
    humidityLv1 = fbdo.intData();
  }
  if (Firebase.getInt(fbdo, "/humidity lv2")) {
    humidityLv2 = fbdo.intData();
  }
  if (Firebase.getInt(fbdo, "/humidity lv3")) {
    humidityLv3 = fbdo.intData();
  }
  if (Firebase.getInt(fbdo, "/humidity lv4")) {
    humidityLv4 = fbdo.intData();
  }

  if (Firebase.getInt(fbdo, "/co2 lv1")) {
    co2Lv1 = fbdo.intData();
  }
  if (Firebase.getInt(fbdo, "/co2 lv2")) {
    co2Lv2 = fbdo.intData();
  }
  if (Firebase.getInt(fbdo, "/co2 lv3")) {
    co2Lv3 = fbdo.intData();
  }
  if (Firebase.getInt(fbdo, "/co2 lv4")) {
    co2Lv4 = fbdo.intData();
  }

  if (Firebase.getInt(fbdo, "/voc lv1")) {
    vocLv1 = fbdo.intData();
  }
  if (Firebase.getInt(fbdo, "/voc lv2")) {
    vocLv2 = fbdo.intData();
  }
  if (Firebase.getInt(fbdo, "/voc lv3")) {
    vocLv3 = fbdo.intData();
  }
  if (Firebase.getInt(fbdo, "/voc lv4")) {
    vocLv4 = fbdo.intData();
  }
}

void updateFirebase() {
  Firebase.setFloat (fbdo,"temperature", iaqSensor.temperature);
  Firebase.setFloat (fbdo,"humidity", iaqSensor.humidity);
  Firebase.setFloat (fbdo,"co2",  iaqSensor.co2Equivalent);
  Firebase.setFloat (fbdo,"voc",  iaqSensor.breathVocEquivalent);
  // Cập nhật ngưỡng nếu có thay đổi trên Firebase
  updateThresholdsFromFirebase();

  // Cập nhật trạng thái runMode từ Firebase
  if (Firebase.getInt(fbdo, "/arlam")) {
    int firebaseRunMode = fbdo.intData(); // Định nghĩa biến firebaseRunMode tại đây
    if (firebaseRunMode != runMode) {
      runMode = firebaseRunMode;
      digitalWrite(ledMode, runMode);
      Serial.println("Firebase Run mode updated: " + String(runMode));
    }
  } else {
    Serial.println("Failed to get alarm from Firebase: " + fbdo.errorReason());
  }
}

void updateSheet() {
  static bool buttonStateSheet = HIGH; // Trạng thái của nút nhấn

  if (digitalRead(BUTTON_PIN_SHEET) == LOW) {
    if (buttonStateSheet == HIGH) {
      buttonStateSheet = LOW;

      // Gửi giá trị 1 lên node "newsheet" trên Firebase
      Firebase.setInt(fbdo, "/newsheet", 1);
      Serial.println("Sent 1 to /newsheet on Firebase");

      // LED chớp tắt 3 lần
      for (int i = 0; i < 3; i++) {
        digitalWrite(LED_PIN_SHEET, HIGH);
        vTaskDelay(200 / portTICK_PERIOD_MS);
        digitalWrite(LED_PIN_SHEET, LOW);
        vTaskDelay(200 / portTICK_PERIOD_MS);
      }

      vTaskDelay(200 / portTICK_PERIOD_MS);  // Debounce cho nút nhấn
    }
  } else {
    buttonStateSheet = HIGH;
  }
}


void sendToThingSpeak() {
  // Đẩy dữ liệu lên ThingSpeak
  ThingSpeak.setField(2, iaqSensor.temperature); // Nhiệt độ
  ThingSpeak.setField(3, iaqSensor.humidity); // Độ ẩm
  ThingSpeak.setField(4, iaqSensor.co2Equivalent); // CO2
  ThingSpeak.setField(5, iaqSensor.breathVocEquivalent); // VOC

  int x = ThingSpeak.writeFields(myChannelNumber, myWriteAPIKey);
  if (x == 200) {
    Serial.println("Channel update successful.");
  } else {
    Serial.println("Problem updating channel. HTTP error code " + String(x));
  }
}

void getThoigian(){
  // Đảm bảo rằng client NTP đã cập nhật thời gian. Nếu không, ép buộc cập nhật.
  while(!timeClient.update()) {
    timeClient.forceUpdate();
  }
  unsigned long epochTime = timeClient.getEpochTime();
  // Trích xuất giờ, phút, và giây từ client thời gian
  gio  = timeClient.getHours();
  phut = timeClient.getMinutes();
  giay = timeClient.getSeconds();
  Serial.println();
  // In thời gian hiện tại theo định dạng HH:MM:SS ra màn hình serial
  Serial.printf("%02d:%02d:%02d",gio,phut,giay);
  // Lấy ngày trong tuần hiện tại dưới dạng chuỗi
  thu  = weekDays[timeClient.getDay()];
  struct tm *ptm = gmtime ((time_t *)&epochTime); 
  ngay  = ptm->tm_mday;
  thang = ptm->tm_mon+1;     // tm_mon từ 0-11, nên cộng thêm 1 để có 1-12
  nam   = ptm->tm_year+1900; // tm_year là số năm kể từ 1900
  Serial.println();
  Serial.printf("%s, %02d-%02d-%d", thu, ngay, thang, nam);
}

void updateTimeLCD(){ 
  //Hien thi thu trong tuan
  tft.setCursor(41, 4);
  tft.setTextColor(YELLOW,BLACK);
  tft.setTextSize(1);
  String weekDay = weekDays[timeClient.getDay()] + ",";
  tft.println(weekDay);
  
  //Print complete date:
  tft.setCursor(67, 4);
  tft.setTextColor(YELLOW,BLACK);
  tft.setTextSize(1);
  String ngay_,thang_;
  if(ngay<10){
    ngay_= "0" + String(ngay);
  }else{
    ngay_=String(ngay);
  }
  if(thang<10){
    thang_= "0" + String(thang);
  }else{
    thang_=String(thang);
  }
  String currentDate = ngay_ + "-" + thang_ + "-" + String(nam);
  tft.println(currentDate);
  
  tft.setCursor(2, 4);
  tft.setTextColor(YELLOW,BLACK);
  tft.setTextSize(1);
  String gio_,phut_;
  if(gio<10){
    gio_= "0" + String(gio);
  }else{
    gio_=String(gio);
  }
  if(phut<10){
    phut_= "0" + String(phut);
  }else{
    phut_=String(phut);
  }
  String formattedTime = gio_ + ":" + phut_;
  tft.print(formattedTime);
}

void updateTime(){
  // Cập nhật thời gian
  giay++;
  if(giay == 60) {
    phut++;
    giay = 0;
  }
  if(phut == 60) {
    gio++;
    phut = 0;
  }
  if(gio == 24) {                              // Sau 1 ngày cập nhật thời gian 1 lần
    gio = 0;
    getThoigian();
  }
}

void LCD(){
  if (xSemaphoreTake(xLcdSemaphore, portMAX_DELAY)) {
        updateTimeLCD();
        updateIAQ();
        checkIAQ();
        xSemaphoreGive(xLcdSemaphore);
    }
}

void checkIaqSensorStatus(void)
{
  if (iaqSensor.bsecStatus != BSEC_OK) {
    if (iaqSensor.bsecStatus < BSEC_OK) {
      output = "BSEC error code : " + String(iaqSensor.bsecStatus);
      Serial.println(output);
      for (;;)
        errLeds(); /* Halt in case of failure */
    } else {
      output = "BSEC warning code : " + String(iaqSensor.bsecStatus);
      Serial.println(output);
    }
  }

  if (iaqSensor.bme68xStatus != BME68X_OK) {
    if (iaqSensor.bme68xStatus < BME68X_OK) {
      output = "BME68X error code : " + String(iaqSensor.bme68xStatus);
      Serial.println(output);
      for (;;)
        errLeds(); /* Halt in case of failure */
    } else {
      output = "BME68X warning code : " + String(iaqSensor.bme68xStatus);
      Serial.println(output);
    }
  }
}

void errLeds(void)
{
  pinMode(LED_BUILTIN, OUTPUT);
  digitalWrite(LED_BUILTIN, HIGH);
  delay(100);
  digitalWrite(LED_BUILTIN, LOW);
  delay(100);
}

void setupLCD(){
  tft.init();                                     //Thiet lap LCD TFT
  tft.fillScreen(BLACK);                          //Thiet lap mau nen LCD
  tft.setRotation(2);
  tft.setSwapBytes(true);                         // Hoan doi Byte de hien thi ro hon
  tft.pushImage(1, 79, 20, 20, nhietdo);
  tft.pushImage(67, 79, 20, 20, doam);
  tft.pushImage(87,148, 40, 7, thangdo);
  tft.pushImage(4,28, 37, 37, airquality);
  printText("PM2.5",WHITE,1,17,1);
  printText("ug/m3",WHITE,97,17,1);
  tft.drawRect(0,0,128,160,CYAN);             
  tft.drawFastHLine(1,15,tft.width(),CYAN);
  tft.drawFastHLine(1,145,tft.width(),CYAN);
  tft.drawLine(65,107,65,145,CYAN);
  tft.drawFastHLine(1,70,tft.width(),CYAN);
  tft.drawFastHLine(1,107,tft.width(),CYAN);
  printText("CO2",WHITE,1,109,1);
  printText("ppm",WHITE,47,109,1);
  printText("VOC",WHITE,66,109,1);
  printText("ppm",WHITE,109,109,1);
  printText("IAQ: ",GREEN,1,148,1);
}

void printText(char *text, uint16_t color, int x, int y,int textSize ){
  tft.setCursor(x, y);
  tft.setTextColor(color,BLACK);
  tft.setTextSize(textSize);
  tft.print(text);
}